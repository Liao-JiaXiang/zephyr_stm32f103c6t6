## boards/arm/stm32f103c6t6/Kconfig.custom_bluepill
```kconfig
# STM32 Minimum Development Board Configuration

# Copyright (c) 2017, embedjournal.com
# SPDX-License-Identifier: Apache-2.0

config BOARD_CUSTOM_BLUEPILL
	select SOC_STM32F103X8
#假装它是 C8T6，不然可能报错。
```

## boards/arm/stm32f103c6t6/board.yml
```yaml
board:
  name: custom_bluepill
  full_name: STM32F103C6T6 Minimum Development Board
  vendor: st
  socs:
    - name: stm32f103xb
#假装它是 Cb系列，不然会报错
```
