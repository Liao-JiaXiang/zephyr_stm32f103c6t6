/*
 * Copyright (c) 2025 Your Company
 *
 * SPDX-License-Identifier: Apache-2.0
 */

/ {
	leds {
		compatible = "gpio-leds";
		userled: led_1 {
			gpios = <&gpioc 13 GPIO_ACTIVE_LOW>;
			label = "LED 1";
			status = "okay";
		};
	};
	
	aliases {
		led1 = &userled;
	};
	
};